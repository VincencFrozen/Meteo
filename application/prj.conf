## CMakeLists.txt
```
# SPDX-License-Identifier: Apache-2.0

cmake_minimum_required(VERSION 3.20.0)

find_package(Zephyr REQUIRED HINTS $ENV{ZEPHYR_BASE})
project(hello_world)

target_include_directories(app PRIVATE . PRIVATE src/)

# TODO: List into variable and add separate CmakeLists into src folder
target_sources(app PRIVATE src/main.cpp)
target_sources(app PRIVATE src/anemometer.cpp)
target_sources(app PRIVATE src/windlogic.cpp)
```

## sample.yaml
```
sample:
  description: Hello World sample, the simplest Zephyr
    application
  name: hello world
common:
  min_ram: 2
  min_flash: 16
  tags: introduction
  # integration_platforms:
  #   - native_sim
  harness: console
  harness_config:
    type: one_line
    regex:
      - "Hello World! (.*)"
tests:
  sample.basic.helloworld:
    tags: introduction
```

## prj.conf
```kconfig
CONFIG_CPP=y
CONFIG_COMMON_LIBC_MALLOC_ARENA_SIZE=12800
CONFIG_CPP_EXCEPTIONS=y
# CONFIG_LIBCPP_IMPLEMENTATION=y
CONFIG_GLIBCXX_LIBCPP=y
CONFIG_REQUIRES_FULL_LIBCPP=y
```

## src/main.c
```c
/*
 * Copyright (c) 2012-2014 Wind River Systems, Inc.
 *
 * SPDX-License-Identifier: Apache-2.0
 */

#include <stdio.h>

int main(void)
{
	printf("Hello Worldd! %s\n", CONFIG_BOARD_TARGET);

	return 0;
}
```

## src/main.cpp
```c
/*
 * Copyright (c) 2012-2014 Wind River Systems, Inc.
 *
 * SPDX-License-Identifier: Apache-2.0
 */

#include <stdio.h>

#include "anemometer.hpp"
#include "windlogic.hpp"

#include <zephyr/kernel.h>

using Anemometer::AnemometerGpioWH1080;
using WindLogic::WindLogicUart;


int main(void)
{
	printf("Hello Worldd! %s\n", CONFIG_BOARD_TARGET);

	AnemometerGpioWH1080 anemo;
	WindLogicUart windLogic(anemo);

	while(1)
	{
		anemo.triggerFromGpio();
		windLogic.process();

		k_sleep(K_MSEC(1000));
	}

	return 0;
}
```

## src/anemometer.cpp
```c
#include "anemometer.hpp"

// TODO: Any kind of factory?

namespace Anemometer {

windSpeedKmh_t AnemometerGpio::getWindSpeed(void) const
{
    return this->windSpeed_kmh;
}

void AnemometerGpio::triggerFromGpio(void)
{
    // Todo. Correct computation

    this->windSpeed_kmh += 1;
}

} // namespace Anemometer
```

## src/anemometer.hpp
```c
#pragma once

#include <stdint.h>

// TODO: Any kind of factory?

namespace Anemometer {

typedef float windSpeedKmh_t;

constexpr windSpeedKmh_t WH1080_KMHPERTICK  = 2.4;
constexpr windSpeedKmh_t DEFAULT_KMHPERTICK = 1;

class IAnemometer 
{
public:
    virtual windSpeedKmh_t getWindSpeed(void) const = 0;
};


class AnemometerGpio : public IAnemometer 
{
public:
    void triggerFromGpio(void);
    windSpeedKmh_t getWindSpeed(void) const override;

private:
    windSpeedKmh_t windSpeed_kmh;

protected:
    windSpeedKmh_t kmhPerTick;
    AnemometerGpio(windSpeedKmh_t kmhPerTick = DEFAULT_KMHPERTICK) : windSpeed_kmh(0.0), kmhPerTick(kmhPerTick) {};
};


class AnemometerGpioWH1080 : public AnemometerGpio
{
public:
    AnemometerGpioWH1080() : AnemometerGpio(WH1080_KMHPERTICK) {};
};

} // namespace Anemometer
```

## src/windlogic.cpp
```c
#include <stdint.h>
#include <iostream>

#include "anemometer.hpp"
#include "windlogic.hpp"

namespace WindLogic {

void WindLogic::process(void)
{
    // Todo: Add Histersis
    triggerWindState((anemometer.getWindSpeed() > windLevelTrershold_kmh) ? WindSeverity::CRITICAL : WindSeverity::OK);
}

void WindLogicUart::triggerWindState(WindSeverity windSeverity)
{
    if(windSeverity == WindSeverity::OK)
    {
        std::cout << "OK" << std::endl;
    } else
    {
        std::cout << "CRITICAL" << std::endl;
    }
}

} // namespace WindLogic
```

## src/windlogic.hpp
```c
#pragma once

#include <stdint.h>
#include "anemometer.hpp"

namespace WindLogic {

constexpr uint32_t DEFAULT_HISTERSIS_S = 30;
constexpr uint32_t DEFAULT_WIND_SPEED_KMH = 30;
constexpr uint32_t DEFAULT_WIND_LEVEL_THRESHOLD_KMH = 10;

enum class WindSeverity 
{
    OK,
    CRITICAL
};


class WindLogic
{
public:
    WindLogic(const Anemometer::IAnemometer & anemometer, Anemometer::windSpeedKmh_t windLevelTrershold_kmh = DEFAULT_WIND_LEVEL_THRESHOLD_KMH
        , uint32_t histersis_s = DEFAULT_HISTERSIS_S)
    : anemometer(anemometer), windLevelTrershold_kmh(windLevelTrershold_kmh), histersis_s(histersis_s) {};

    void process(void);

private:
    const Anemometer::IAnemometer & anemometer;
    Anemometer::windSpeedKmh_t windLevelTrershold_kmh;
    uint32_t histersis_s;

    virtual void triggerWindState(WindSeverity windSeverity) = 0;
};

class WindLogicUart : public WindLogic
{
public:
    using WindLogic::WindLogic;

private:
    void triggerWindState(WindSeverity windSeverity) override;
};


} // namespace WindLogic
```
